#define ZMK_POINTING_DEFAULT_MOVE_VAL 1200  // 600
#define ZMK_POINTING_DEFAULT_SCRL_VAL 25   // 10

#include <input/processors.dtsi>
#include <zephyr/dt-bindings/input/input-event-codes.h>
#include <behaviors.dtsi>
#include <dt-bindings/zmk/bt.h>
#include <dt-bindings/zmk/keys.h>
#include <dt-bindings/zmk/outputs.h>
#include <dt-bindings/zmk/pointing.h>
#include <dt-bindings/zmk/rgb.h>

&mmv_input_listener { input-processors = <&zip_xy_scaler 2 1>; };

&msc_input_listener { input-processors = <&zip_scroll_scaler 2 1>; };

&msc {
    acceleration-exponent = <1>;      // 0
    time-to-max-speed-ms = <100>;       // 300
    delay-ms = <0>;                   // 0
};

&mmv {
    time-to-max-speed-ms = <500>;
    acceleration-exponent = <1>;
    trigger-period-ms = <16>;
};

&soft_off { hold-time-ms = <2000>; };

/ {
    scroll_encoder: scroll_encoder {
        compatible = "zmk,behavior-sensor-rotate";
        #sensor-binding-cells = <0>;
        bindings = <&msc SCRL_DOWN>, <&msc SCRL_UP>;

        tap-ms = <100>;
    };

    behaviors {
        /* === Accented characters via behavior-mod-morph === */
        e_acute: e_acute {
            compatible = "zmk,behavior-mod-morph";
            #binding-cells = <0>;
            mods = <(MOD_LSFT | MOD_RSFT)>;
            bindings = <&ALT_E_ACUTE, &ALT_E_ACUTE_CAP>;
        };

        e_grave: e_grave {
            compatible = "zmk,behavior-mod-morph";
            #binding-cells = <0>;
            mods = <(MOD_LSFT | MOD_RSFT)>;
            bindings = <&ALT_E_GRAVE, &ALT_E_GRAVE_CAP>;
        };

        e_circ: e_circ {
            compatible = "zmk,behavior-mod-morph";
            #binding-cells = <0>;
            mods = <(MOD_LSFT | MOD_RSFT)>;
            bindings = <&ALT_E_CIRC, &ALT_E_CIRC_CAP>;
        };

        a_grave: a_grave {
            compatible = "zmk,behavior-mod-morph";
            #binding-cells = <0>;
            mods = <(MOD_LSFT | MOD_RSFT)>;
            bindings = <&ALT_A_GRAVE, &ALT_A_GRAVE_CAP>;
        };

        c_ced: c_ced {
            compatible = "zmk,behavior-mod-morph";
            #binding-cells = <0>;
            mods = <(MOD_LSFT | MOD_RSFT)>;
            bindings = <&ALT_C_CED, &ALT_C_CED_CAP>;
        };

        i_circ: i_circ {
            compatible = "zmk,behavior-mod-morph";
            #binding-cells = <0>;
            mods = <(MOD_LSFT | MOD_RSFT)>;
            bindings = <&ALT_I_CIRC, &ALT_I_CIRC_CAP>;
        };

        o_circ: o_circ {
            compatible = "zmk,behavior-mod-morph";
            #binding-cells = <0>;
            mods = <(MOD_LSFT | MOD_RSFT)>;
            bindings = <&ALT_O_CIRC, &ALT_O_CIRC_CAP>;
        };

        u_grave: u_grave {
            compatible = "zmk,behavior-mod-morph";
            #binding-cells = <0>;
            mods = <(MOD_LSFT | MOD_RSFT)>;
            bindings = <&ALT_U_GRAVE, &ALT_U_GRAVE_CAP>;
        };
    };

    combos {
        compatible = "zmk,combos";

        softoff {
            bindings = <&soft_off>;
            key-positions = <14 28 40>;
        };
    };

    macros {
        /* === Example SHIFT + mouse click macro === */
        SHIFT_MCLK: SHIFT_MCLK {
            compatible = "zmk,behavior-macro";
            #binding-cells = <0>;
            bindings = <
                &macro_press &kp LEFT_SHIFT
                &macro_press &mkp MB3
                &macro_pause_for_release
                &macro_release
                &kp LEFT_SHIFT
                &mkp MB3
            >;
            label = "SHIFT_MCLK";
        };

        /* === Accented character macros === */

        ALT_E_ACUTE: ALT_E_ACUTE {
            compatible = "zmk,behavior-macro";
            #binding-cells = <0>;
            bindings = <
                &macro_press &kp LEFT_ALT
                &kp KP_N0 KP_N2 KP_N3 KP_N3
                &macro_release &kp LEFT_ALT
            >;
        };
        ALT_E_ACUTE_CAP: ALT_E_ACUTE_CAP {
            compatible = "zmk,behavior-macro";
            #binding-cells = <0>;
            bindings = <
                &macro_press &kp LEFT_ALT
                &kp KP_N0 KP_N2 KP_N0 KP_N1
                &macro_release &kp LEFT_ALT
            >;
        };

        ALT_E_GRAVE: ALT_E_GRAVE {
            compatible = "zmk,behavior-macro";
            #binding-cells = <0>;
            bindings = <
                &macro_press &kp LEFT_ALT
                &kp KP_N0 KP_N2 KP_N3 KP_N2
                &macro_release &kp LEFT_ALT
            >;
        };
        ALT_E_GRAVE_CAP: ALT_E_GRAVE_CAP {
            compatible = "zmk,behavior-macro";
            #binding-cells = <0>;
            bindings = <
                &macro_press &kp LEFT_ALT
                &kp KP_N0 KP_N2 KP_N0 KP_N0
                &macro_release &kp LEFT_ALT
            >;
        };

        ALT_E_CIRC: ALT_E_CIRC {
            compatible = "zmk,behavior-macro";
            #binding-cells = <0>;
            bindings = <
                &macro_press &kp LEFT_ALT
                &kp KP_N0 KP_N2 KP_N3 KP_N4
                &macro_release &kp LEFT_ALT
            >;
        };
        ALT_E_CIRC_CAP: ALT_E_CIRC_CAP {
            compatible = "zmk,behavior-macro";
            #binding-cells = <0>;
            bindings = <
                &macro_press &kp LEFT_ALT
                &kp KP_N0 KP_N2 KP_N0 KP_N2
                &macro_release &kp LEFT_ALT
            >;
        };

        /* === Repeat pattern for A, C, I, O, U accents === */

        ALT_A_GRAVE: ALT_A_GRAVE {
            compatible = "zmk,behavior-macro";
            #binding-cells = <0>;
            bindings = <
                &macro_press &kp LEFT_ALT
                &kp KP_N0 KP_N2 KP_N2 KP_N4
                &macro_release &kp LEFT_ALT
            >;
        };
        ALT_A_GRAVE_CAP: ALT_A_GRAVE_CAP {
            compatible = "zmk,behavior-macro";
            #binding-cells = <0>;
            bindings = <
                &macro_press &kp LEFT_ALT
                &kp KP_N0 KP_N1 KP_N9 KP_N2
                &macro_release &kp LEFT_ALT
            >;
        };

        ALT_C_CED: ALT_C_CED {
            compatible = "zmk,behavior-macro";
            #binding-cells = <0>;
            bindings = <
                &macro_press &kp LEFT_ALT
                &kp KP_N0 KP_N2 KP_N3 KP_N1
                &macro_release &kp LEFT_ALT
            >;
        };
        ALT_C_CED_CAP: ALT_C_CED_CAP {
            compatible = "zmk,behavior-macro";
            #binding-cells = <0>;
            bindings = <
                &macro_press &kp LEFT_ALT
                &kp KP_N0 KP_N1 KP_N9 KP_N9
                &macro_release &kp LEFT_ALT
            >;
        };

        /* ...repeat same structure for I, O, U accented macros... */
    };
};


    keymap {
        compatible = "zmk,keymap";

        layer0 {
            bindings = <
&kp ESC     &kp N1     &kp N2        &kp N3        &kp N4  &kp N5       &kp UP_ARROW     &kp N6     &kp N7     &kp N8     &kp N9           &kp N0      &kp BACKSPACE
&kp TAB     &kp Q      &kp W         &kp E         &kp R   &kp T        &kp DOWN_ARROW   &kp Y      &kp U      &kp I      &kp O            &kp P       &kp BSLH
&kp CAPS    &kp A      &kp S         &kp D         &kp F   &kp G        &kp LEFT_ARROW   &kp H      &kp J      &kp K      &kp L            &kp SEMI    &kp APOS
&kp LSHFT   &kp Z      &kp X         &kp C         &kp V   &kp B        &kp RIGHT_ARROW  &kp N      &kp M      &kp COMMA  &kp DOT          &kp FSLH    &kp ENTER
&kp C_MUTE  &kp LCTRL  &kp LEFT_GUI  &kp LEFT_ALT  &mo 1   &kp SPACE    &kp ENTER        &kp SPACE  &kp ENTER  &mo 2      &kp RIGHT_SHIFT  &kp DELETE
            >;

            sensor-bindings = <&inc_dec_kp C_VOLUME_UP C_VOL_DN>;
            display-name = "LAYER0";
        };

        layer_1 {
            bindings = <
                &kp GRAVE   &kp F1           &kp F2          &kp F3           &kp F4           &kp F5             &mmv MOVE_UP     &kp F6           &kp F7           &kp F8      &kp F9     &kp F10           &trans
                &trans      &kp GRAVE        &mkp LCLK       &mkp MCLK        &mkp RCLK        &mkp MB4           &mmv MOVE_DOWN   &kp PG_UP        &kp END          &kp UP      &kp HOME   &kp MINUS         &kp EQUAL
                &trans      &kp TILDE        &trans          &trans           &trans           &mkp MB5           &mmv MOVE_LEFT   &kp PG_DN        &kp LEFT         &kp DOWN    &kp RIGHT  &kp LEFT_BRACKET  &kp RIGHT_BRACKET
                &trans      &rgb_ug RGB_OFF  &rgb_ug RGB_ON  &rgb_ug RGB_EFF  &rgb_ug RGB_EFR  &rgb_ug RGB_SPI    &mmv MOVE_RIGHT  &rgb_ug RGB_BRI  &rgb_ug RGB_BRD  &kp INSERT  &kp F11    &kp F12           &trans
                &kp C_MUTE  &trans           &trans          &trans           &trans           &trans             &mkp LCLK        &kp MINUS        &kp PLUS         &kp EQUAL   &kp LEFT_BRACKET &kp RIGHT_BRACKET
            >;

            display-name = "layer1";
            sensor-bindings = <&scroll_encoder>;
        };

        layer_2 {
            bindings = <
&kp TILDE  &bt BT_SEL 0  &bt BT_SEL 1    &bt BT_SEL 2  &bt BT_SEL 3  &bt BT_SEL 4    &mmv MOVE_UP     &kp F6          &kp F7  &kp F8      &kp F9     &kp F10      &trans
&trans     &trans        &trans          &e_circ       &e_acute      &e_grave        &mmv MOVE_DOWN   &bt BT_CLR      &bt BT_CLR_ALL      &kp F11    &kp F12      &kp UNDER    &kp PLUS
&trans     &a_grave      &trans          &trans        &trans        &trans          &mmv MOVE_LEFT   &out OUT_USB    &out OUT_BLE        &trans     &trans       &kp LBRC     &kp RBRC
&trans     &trans        &trans          &c_ced        &trans        &trans          &mmv MOVE_RIGHT  &trans  &trans  &sys_reset          &soft_off  &bootloader  &trans
&trans     &trans        &trans          &trans        &trans        &trans          &mkp LCLK        &trans  &trans  &trans              &trans     &trans
            >;

            display-name = "layer2";
            sensor-bindings = <&scroll_encoder>;
        };

        layer_3 {
            bindings = <
&trans  &trans  &trans  &trans  &trans  &trans    &trans  &trans  &trans  &trans  &trans  &trans  &trans
&trans  &trans  &trans  &trans  &trans  &trans    &trans  &trans  &trans  &trans  &trans  &trans  &trans
&trans  &trans  &trans  &trans  &trans  &trans    &trans  &trans  &trans  &trans  &trans  &trans  &trans
&trans  &trans  &trans  &trans  &trans  &trans    &trans  &trans  &trans  &trans  &trans  &trans  &trans
&trans  &trans  &trans  &trans  &trans  &trans    &trans  &trans  &trans  &trans  &trans  &trans
            >;

            display-name = "layer3";
            sensor-bindings = <&scroll_encoder>;
        };

        layer_4 {
            bindings = <
&trans  &trans  &trans  &trans  &trans  &trans    &trans  &trans  &trans  &trans  &trans  &trans  &trans
&trans  &trans  &trans  &trans  &trans  &trans    &trans  &trans  &trans  &trans  &trans  &trans  &trans
&trans  &trans  &trans  &trans  &trans  &trans    &trans  &trans  &trans  &trans  &trans  &trans  &trans
&trans  &trans  &trans  &trans  &trans  &trans    &trans  &trans  &trans  &trans  &trans  &trans  &trans
&trans  &trans  &trans  &trans  &trans  &trans    &trans  &trans  &trans  &trans  &trans  &trans
            >;

            display-name = "layer4";
            sensor-bindings = <&scroll_encoder>;
        };
    };
};

